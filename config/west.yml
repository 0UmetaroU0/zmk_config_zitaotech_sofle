## config/west.yml
```yaml
manifest:
  remotes:
    - name: cormoran
      url-base: https://github.com/cormoran

  projects:
    - name: zmk-module-runtime-input-processor
      remote: cormoran
      revision: zmk-v0.3.0.0

    - name: zmk-feature-custom-settings
      url: https://github.com/0UmetaroU0/zmk-feature-custom-settings-v03
      revision: v0.3-port

    - name: zmk-feature-runtime-macro
      url: https://github.com/0UmetaroU0/zmk-feature-runtime-macro-v03
      revision: main

    - name: zmk
      remote: cormoran
      revision: v0.3+custom-studio-protocol
      import:
        file: app/west.yml

  self:
    path: config
```
